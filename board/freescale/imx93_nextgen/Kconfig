## board/freescale/imx93_nextgen/Kconfig
```kconfig
if TARGET_IMX93_NEXTGEN

config SYS_BOARD
	default "imx93_nextgen"

config SYS_VENDOR
	default "freescale"

config SYS_CONFIG_NAME
	default "imx93_nextgen"

endif
```
